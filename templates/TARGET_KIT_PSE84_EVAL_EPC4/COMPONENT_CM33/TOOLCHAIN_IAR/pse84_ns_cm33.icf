/***************************************************************************//**
* \file pse84_ns_cm33.icf
* \version 1.0.0
*
* Linker file for the IAR compiler.
*
* The main purpose of the linker script is to describe how the sections in the
* input files should be mapped into the output file, and to control the memory
* layout of the output file.
*
*
* \note The linker files included with the PDL template projects must be generic
* and handle all common use cases. Your project may not use every section
* defined in the linker files. In that case you may see warnings during the
* build process. In your project, you can simply comment out or remove the
* relevant code in the linker file.
*
********************************************************************************
* \copyright
* Copyright (c) (2020-2025), Cypress Semiconductor Corporation (an Infineon company) or
* an affiliate of Cypress Semiconductor Corporation.
* SPDX-License-Identifier: Apache-2.0
*
* Licensed under the Apache License, Version 2.0 (the "License");
* you may not use this file except in compliance with the License.
* You may obtain a copy of the License at
*
*     http://www.apache.org/licenses/LICENSE-2.0
*
* Unless required by applicable law or agreed to in writing, software
* distributed under the License is distributed on an "AS IS" BASIS,
* WITHOUT WARRANTIES OR CONDITIONS OF ANY KIND, either express or implied.
* See the License for the specific language governing permissions and
* limitations under the License.
*******************************************************************************/

/* Include the device memory definitions generated by the Device Configurator */
include  "../../config/GeneratedSource/cymem_ilinkarm_CM33_0.icf";

/* Define the stack size for the application
  To set stack size in application add makefile ldflags: --config_def APP_MSP_STACK_SIZE=<CUSTOM_VALUE> */
if (!isdefinedsymbol(APP_MSP_STACK_SIZE))
{
  /* default stack size */
  define symbol APP_MSP_STACK_SIZE = 0x00001000;
}
define symbol __ICFEDIT_size_cstack__ = APP_MSP_STACK_SIZE;

/* Defines the minimum heap size. The actual heap size will be expanded to the end of the stack region */
if (!isdefinedsymbol(HEAP_SIZE))
{
  /* default heap size */
  define symbol HEAP_SIZE = 0x00001000;
}
define symbol __ICFEDIT_size_heap__ = HEAP_SIZE;

/* Device definitions */
define symbol VECTORS_ALIGNMENT = 0x400;
define symbol __ICFEDIT_intvec_start__ = CYMEM_CM33_0_m33_nvm_sel_START;

define memory mem with size = 4G;

/* The size of the MCU boot header area at the start of main code region */
define symbol MCUBOOT_HEADER_SIZE = 0x400;

/* Include the memory regions generated by the Device Configurator.
  This file contains the memory region definitions for the device,
  which are used to define the memory layout in this linker script. */

include  "../../config/GeneratedSource/cymem_ilinkarm_regions_CM33_0.icf";

/* Block definitions */

/* Define a block for performance-sensitive or critical functions that need to be executed in SRAM */
define block FLASH_BOOT with alignment = VECTORS_ALIGNMENT, fixed order
{
  readonly section .intvec,
  readonly section .iar.init_table,
  readonly object ns_start_pse84.*,
  readonly object ns_system_pse84.*,
  readonly object system_edge.*,
  readonly object cy_device.*,
  readonly object *startup*.*,
  readonly object cmain.*,
  readonly object data_init.*,
  readonly object zero_init*.*,
  readonly object copy_init*.*
};
define block RAM_APP with alignment = 4
{
  readwrite code
};

/* Define the stack and heap blocks */
define block CSTACK with alignment = 8, size = __ICFEDIT_size_cstack__ { };
define block HEAP with expanding size, alignment = 8, minimum size = __ICFEDIT_size_heap__ { };

/* Define the RAM data and bss blocks */
define block RAM_DATA { readwrite section .data };
define block RAM_BSS { readwrite section .bss };
define block RAM_OTHER { readwrite section * };
define block RAM_NOINIT { readwrite section .noinit };
define block RAM with fixed order { block RAM_DATA, block RAM_OTHER, block RAM_NOINIT, block RAM_BSS };

/* Define the RAM vector block */
define block RAM_VECTOR with alignment = VECTORS_ALIGNMENT { section .intvec_ram };

/* Initialization */
do not initialize { section .noinit, section .intvec_ram, section .cy_sharedmem  };
initialize by copy
{
  readwrite,
  readonly
};

/* Placement */
/* Serial Memory Interface block #0 memory #1, 16 MB */
/* A reserved region for MCUBoot header */
reserve region "MCUBOOT_HEADER" = [from start(m33_nvm_sel) size MCUBOOT_HEADER_SIZE];
/* A reserved region for the trail space for the signature used by the bootloader - do not place any code here */
reserve region "M33_TRAILER" = [from (start(m33_trailer_sel)) size CYMEM_CM33_0_m33_trailer_SIZE ];
place in m33_nvm_sel { first block FLASH_BOOT, readonly };

/* SRAM, 1 MB */

/* A piece intended for code placement */
place in m33_code { block RAM_APP };

/* A piece intended for data placement */
place at start of m33_data { block RAM_VECTOR };
place in          m33_data { block RAM, block HEAP };
place at end   of m33_data { block CSTACK };

/* A piece intended for shared RAM memory where only the Cortex-M33 Non Secure can allocate data but all cores can access*/
place in m33_allocatable_shared { section .cy_sharedmem };

/* System SRAM (SoCMEM), 5 MB */

/* A piece intended for shared RAM memory placement */
place in m33_m55_shared { section .cy_shared_socmem };

/* A piece intended for GPU buffer */
place in gfx_mem { section .cy_gpu_buf };

keep { section .intvec };
